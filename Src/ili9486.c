#include "ili9486.h"
#include "hal.h"


const int ili9486_init[] = {
	// Interface Mode Control
	-1, 0xb0, 0x0,
	// Sleep OUT
	-1, 0x11,
	-2, 250,
	// Interface Pixel Format, 16 bits / pixel
	-1, 0x3A, 0x55,
	// Memory Access Control
	-1, 0x36, 0x28,
	// Power Control 3 (For Normal Mode)
	-1, 0xC2, 0x44,
	// VCOM Control
	-1, 0xC5, 0x00, 0x00, 0x00, 0x00,
	// PGAMCTRL(Positive Gamma Control)
	-1, 0xE0, 0x0F, 0x1F, 0x1C, 0x0C, 0x0F, 0x08, 0x48, 0x98, 0x37, 0x0A,
		0x13, 0x04, 0x11, 0x0D, 0x00,
	// NGAMCTRL (Negative Gamma Correction)
	-1, 0xE1, 0x0F, 0x32, 0x2E, 0x0B, 0x0D, 0x05, 0x47, 0x75, 0x37, 0x06,
		0x10, 0x03, 0x24, 0x20, 0x00,
	// Digital Gamma Control 1
	-1, 0xE2, 0x0F, 0x32, 0x2E, 0x0B, 0x0D, 0x05, 0x47, 0x75, 0x37, 0x06,
		0x10, 0x03, 0x24, 0x20, 0x00,
	// Memory Access Control, BGR
	-1, 0x36, 0x28,
	// # Sleep OUT
	-1, 0x11,
	// Display ON
	-1, 0x29,
	-2, 250,
	-3};

const int small_font_width = 8;
const int small_font_height = 12;
const int small_font_start = 0x20;
const int small_font_size = 94;
const unsigned char small_font[] = {
0x00,0x00,0x00,0x00,0x00,0x00,0x00,0x00,0x00,0x00,0x00,0x00, // <Space>
0x00,0x00,0x20,0x20,0x20,0x20,0x20,0x20,0x00,0x20,0x00,0x00, // !
0x00,0x28,0x50,0x50,0x00,0x00,0x00,0x00,0x00,0x00,0x00,0x00, // "
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0x40,0xA4,0x18,0x00,0x00,0x00,0x00,0x00,0x00,0x00,0x00,0x00, // ~
}; 

#define MIN(a,b)	(((a) < (b)) ? (a) : (b))

void ms_delay(unsigned ms)
{
	unsigned x;
	while (ms > 0) {
		x=4*5971;
		while (x > 0) {
			__asm("nop");
			x--;
		}
		ms--;
	}
}

void XSPI_SendData(uint16_t data)
{
	GPIO_SetBit(GPIO_PORT, CE0_GPIO, 0);
    HAL_GPIO_WritePin(GPIOF, CE0_GPIO, 0);

	if (SPI_SendData(SPI_PORT, &data, 1)) {
        while (1);
    }

	GPIO_SetBit(GPIO_PORT, CE0_GPIO, 1);
    HAL_GPIO_WritePin(GPIOF, CE0_GPIO, 1);
}

void XSPI_SendDataSize(uint16_t data, int size)
{
	GPIO_SetBit(GPIO_PORT, CE0_GPIO, 0);

	if (SPI_SendData(SPI_PORT, &data, size)) {
        while (1);
    }

	GPIO_SetBit(GPIO_PORT, CE0_GPIO, 1);
}

void SendCmd(uint16_t cmd)
{
	GPIO_SetBit(GPIO_PORT, DC_GPIO, 0);
	XSPI_SendData(cmd);
}

void SendData(uint16_t data)
{
	GPIO_SetBit(GPIO_PORT, DC_GPIO, 1);
	XSPI_SendData(data);
}

void ILI9486_Init(void)
{
	int done = 0;
	int const *cmd = ili9486_init;
	int is_cmd = 0;

	/* Reset LCD */
	GPIO_SetBit(GPIO_PORT, RS_GPIO, 1);
    ms_delay(10);
	GPIO_SetBit(GPIO_PORT, RS_GPIO, 0);
    ms_delay(10);
	GPIO_SetBit(GPIO_PORT, RS_GPIO, 1);
    ms_delay(10);

	/* Write init code */
	while (!done) {
		switch (*cmd) {
		case -1:
			is_cmd = 1;
			break;
		case -2:
			cmd++;
			ms_delay(*cmd);
			break;
		case -3:
			done = 1;
			break;
		default:
			if (is_cmd) {
				SendCmd((uint16_t) *cmd);
				is_cmd = 0;
			}
			else
				SendData((uint16_t) *cmd);

			break;
		}
		cmd++;
	}
}

uint16_t Color16(uint8_t r, uint8_t g, uint8_t b)
{
	uint16_t color;

	color  = ((uint16_t)(r >> 3) & 0x1F) << 11;
	color |= ((uint16_t)(g >> 2) & 0x3F) << 5;
	color |= ((uint16_t)(b >> 3) & 0x1F);

	return color;
}


void ILI9486_DrawPixels(int x, int y, int w, int h, uint16_t *color)
{
	/* Set X coord */
	SendCmd(0x2A);
	SendData(x >> 8);
	SendData(x);
	SendData((x+w-1) >> 8);
	SendData(x+w);

	/* Set Y coord */
	SendCmd(0x2B);
	SendData(y >> 8);
	SendData(y);
	SendData((y+h-1) >> 8);
	SendData(y+h-1);

	/* Write data */
	SendCmd(0x2C);
    // for (int i = 0; i < w*h; i++) {
    //     SendData(*(color+i));
    // }
  	GPIO_SetBit(GPIO_PORT, DC_GPIO, 1);
    XSPI_SendDataSize(color, w*h);

}

int font_is_set(unsigned char c, int x, int y)
{
	char byte;
	int val = (int) c - small_font_start;

	if (val < 0 || val >= small_font_size)
		return 0;
	if (x > small_font_width || y > small_font_height)
		return 0;

	byte = small_font[val * small_font_height + y];

	return (byte << x) & 0x80;
}

void lcd_char(char c, int x, int y, uint16_t color)
{
	int i, j;

	for (i = 0; i < small_font_height; i++) {
		for (j = 0; j < small_font_width; j++) {
			if (font_is_set(c, j, i))
				ILI9486_DrawPixels(x, y, 1, 1, &color);
			x += 1;
		}
		x -= 8;
		y += 1;
	}
}

void LCD_Printf(const char *str, int x, int y, uint16_t color)
{
	const char *c = str;
	int x_s = x;

	while (*c != '\0') {
		if (*c == '\n') {
			y += 13;
			x = x_s;
		}
		else {
			lcd_char(*c, x, y, color);
			x += 9;
		}
		c++;
	}
}